#include "skeletyl.dtsi"

&kscan0 {
    wakeup-source;
    diode-direction = "row2col";
    row-gpios
        = <&pro_micro 3 (GPIO_ACTIVE_LOW)> // row0
        , <&pro_micro 5 (GPIO_ACTIVE_LOW)> // row1
        , <&pro_micro 4 (GPIO_ACTIVE_LOW)> // row2
        , <&pro_micro 7 (GPIO_ACTIVE_LOW)> // row3
        ; 
    col-gpios
        = <&pro_micro 19 (GPIO_ACTIVE_LOW | GPIO_PULL_UP)> // col5
        , <&pro_micro 18 (GPIO_ACTIVE_LOW | GPIO_PULL_UP)> // col6
        , <&pro_micro 15 (GPIO_ACTIVE_LOW | GPIO_PULL_UP)> // col7
        , <&pro_micro 14 (GPIO_ACTIVE_LOW | GPIO_PULL_UP)> // col8
        , <&pro_micro 16 (GPIO_ACTIVE_LOW | GPIO_PULL_UP)> // col9
        ;
};
