## config/boards/shields/cygnus/Kconfig.shield
```kconfig
# Copyright (c) 2020 The ZMK Contributors
# SPDX-License-Identifier: MIT

config SHIELD_CYGNUS_LEFT
	def_bool $(shields_list_contains,CYGNUS_left)

config SHIELD_CYGNUS_RIGHT
	def_bool $(shields_list_contains,CYGNUS_right)
```

## config/boards/shields/draculad/Kconfig.defconfig
```kconfig
# Copyright (c) 2020 The ZMK Contributors
# SPDX-License-Identifier: MIT

if SHIELD_DRACULAD_DONGLE

config ZMK_KEYBOARD_NAME
	default "draculad Dongle"
	
config ZMK_SPLIT_BLE_ROLE_CENTRAL
	default y
	
config ZMK_USB
	default y

endif

if SHIELD_DRACULAD_LEFT || SHIELD_DRACULAD_RIGHT || SHIELD_DRACULAD_DONGLE 

config ZMK_SPLIT
	default y

config ZMK_BLE
	default y
	
endif
```

## config/boards/shields/skeletyl/Kconfig.defconfig
```kconfig
# Copyright (c) 2020 The ZMK Contributors
# SPDX-License-Identifier: MIT

if SHIELD_SKELETYL_DONGLE

config ZMK_KEYBOARD_NAME
	default "skeletyl Dongle"
	
config ZMK_SPLIT_BLE_ROLE_CENTRAL
	default y
	
config ZMK_USB
	default y

endif

if SHIELD_SKELETYL_LEFT || SHIELD_SKELETYL_RIGHT || SHIELD_SKELETYL_DONGLE 

config ZMK_SPLIT
	default y

config ZMK_BLE
	default y
	
endif
```

## config/boards/shields/skeletyl/Kconfig.shield
```kconfig
# Copyright (c) 2020 The ZMK Contributors
# SPDX-License-Identifier: MIT

config SHIELD_DRACULAD_LEFT
	def_bool $(shields_list_contains,draculad_left)

config SHIELD_DRACULAD_RIGHT
	def_bool $(shields_list_contains,draculad_right)

config SHIELD_DRACULAD_DONGLE
	def_bool $(shields_list_contains,draculad_dongle)
```

## config/west.yml
```yaml
manifest:
  remotes:
    - name: zmkfirmware
      url-base: https://github.com/zmkfirmware
  projects:
    - name: zmk
      remote: zmkfirmware
      revision: 8feeb52eafc716c1697cfe0515e98b78281c3543
      import: app/west.yml
  self:
    path: config
```
